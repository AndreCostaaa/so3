## so3/configs/virt64_lvperf_defconfig
```kconfig
# CONFIG_ARCH_ARM32 is not set
CONFIG_ARCH_ARM64=y
# CONFIG_SO3VIRT is not set
CONFIG_ARCH="arm64"
CONFIG_CROSS_COMPILE="aarch64-none-elf-"
# CONFIG_ARM_TRUSTZONE is not set
CONFIG_KERNEL_VADDR=0xffff800000000000

#
# Platform
#
CONFIG_VIRT64=y
# CONFIG_RPI4_64 is not set
# CONFIG_VA_BITS_39 is not set
CONFIG_VA_BITS_48=y
# end of Platform

# CONFIG_THREAD_ENV is not set
CONFIG_PROC_ENV=y

#
# Kernel & CPU features
#
# CONFIG_SMP is not set
CONFIG_NR_CPUS=1
CONFIG_HZ=100
CONFIG_SCHED_FLIP_SCHEDFREQ=30
# end of Kernel & CPU features

#
# SO3 Scheduling configuration
#
CONFIG_SCHED_RR=y
# CONFIG_SCHED_PRIO is not set
CONFIG_SCHED_FREQ_PREEMPTION=y
# end of SO3 Scheduling configuration

#
# Drivers
#
CONFIG_UART=y
CONFIG_IO_MAPPING_BASE=0xffff900000000000
# CONFIG_I2C is not set
# CONFIG_NET is not set
CONFIG_FB=y
CONFIG_INPUT=y
# CONFIG_NS16550 is not set
CONFIG_PL011_UART=y
CONFIG_UART_LL_PADDR=0x09000000
# CONFIG_MMC is not set
CONFIG_RAMDEV=y
CONFIG_ARM_TIMER=y
CONFIG_GIC=y
# CONFIG_PL111_CLCD is not set
# CONFIG_QEMU_RAMFB is not set
CONFIG_VIRTFB=y
# CONFIG_PL050_KMI is not set
CONFIG_VIRT_INPUT=y
# end of Drivers

#
# SO3 Applications
#
CONFIG_APP_SAMPLE=y
# CONFIG_APP_REFSO3 is not set
# end of SO3 Applications

#
# Filesystems
#
CONFIG_FS_FAT=y
# CONFIG_ROOTFS_NONE is not set
# CONFIG_ROOTFS_MMC is not set
CONFIG_ROOTFS_RAMDEV=y
# end of Filesystems

#
# IPC
#
CONFIG_IPC_SIGNAL=y
CONFIG_IPC_PIPE=y
# end of IPC

CONFIG_HEAP_SIZE=8
# CONFIG_RTOS is not set
# CONFIG_AVZ is not set
CONFIG_USER_INIT_PROGRAM="lvgl_benchmark.elf"
# CONFIG_SOO is not set
CONFIG_MMU=y
```

## so3/devices/input/Kconfig
```kconfig
config PL050_KMI
	bool "PL050 Keyboard/Mouse Interface"
	depends on VIRT32 || VIRT64

config SOO_INPUT
	bool "SOO Virtualized input device"
	depends on SOO && !AVZ

config VIRT_INPUT
	bool "Virtual input device"
	depends on VIRT32 || VIRT64
```
